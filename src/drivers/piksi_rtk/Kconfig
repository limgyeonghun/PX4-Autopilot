## src/drivers/piksi_rtk/Kconfig
```kconfig
menuconfig DRIVERS_PIKSI_RTK
	bool "piksi_rtk"
	default n
	---help---
		Enable support for XXX
```

## src/modules/monitoring/Kconfig
```kconfig
menuconfig MODULES_MONITORING
	bool "monitoring"
	default n
	---help---
		Enable support for monitoring
```
